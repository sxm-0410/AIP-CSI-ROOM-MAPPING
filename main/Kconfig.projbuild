## main/Kconfig.projbuild
```kconfig
menu "Example Configuration"

    config EXAMPLE_WIFI_SSID
        string "WiFi SSID"
        default "myssid"
        help
            Name of the 2.4 GHz network the board joins.

    config EXAMPLE_WIFI_PASSWORD
        string "WiFi Password"
        default "mypassword"
        help
            WiFi password (WPA or WPA2).

endmenu

menu "Motion Detector Configuration"

    config MOTION_LED_GPIO
        int "LED GPIO"
        range 0 39
        default 19
        help
            GPIO driving the detection LED (through a resistor).

    config MOTION_SAMPLE_MS
        int "RSSI sample period (ms)"
        range 20 1000
        default 100

    config MOTION_WINDOW
        int "Sliding window (samples)"
        range 4 64
        default 10
        help
            Samples per variation window. Smaller reacts faster (10 = 1 s at 10 Hz).

    config MOTION_CALIB_SAMPLES
        int "Calibration length (windows)"
        range 10 200
        default 100
        help
            Empty-path baseline is learned at boot (LED blinks, ~11 s). Keep the path clear.
            Only the quietest 60% of this period sets the limits, so a short walk-by is tolerated.

    config MOTION_K_SIGMA_X10
        int "Threshold sensitivity k (x10)"
        range 10 100
        default 40
        help
            Limit = median + k * robust spread of the empty-path variation. Lower = more sensitive.

    config MOTION_MIN_STD_MARGIN_X10
        int "Minimum std margin above baseline (dB x10)"
        range 1 100
        default 5

    config MOTION_LEVEL_SHIFT_DB
        int "Smallest RSSI level shift that counts as an object (dB)"
        range 1 30
        default 2
        help
            Catches an object left in the path (the signal level moves). The board learns the
            real limit from the empty path; this is the lowest value it may use.

    config MOTION_HOLD_MS
        int "LED hold time after last motion (ms)"
        range 0 30000
        default 2000

    config MOTION_PROBE_TRAFFIC
        bool "Ping the router so RSSI/CSI refresh often"
        default y

    config MOTION_PROBE_MS
        int "Ping interval (ms) = CSI packet rate"
        depends on MOTION_PROBE_TRAFFIC
        range 5 1000
        default 100
        help
            100 ms = 10 CSI packets/s. Faster pings can trip router flood protection.

    config CSI_STREAM
        bool "Stream raw CSI over serial (for data collection / ML)"
        default n
        select ESP_WIFI_CSI_ENABLED
        help
            Needs the console at 460800 baud (set in sdkconfig). Lines:
            CSI_DATA,seq,ms,rssi,len,[b0,b1,...]

    config MOTION_OLED
        bool "Show status on an SSD1306 OLED (I2C)"
        default y

    config MOTION_OLED_HEIGHT
        int "OLED height in pixels (64 or 32)"
        depends on MOTION_OLED
        default 64

    config MOTION_OLED_SDA
        int "OLED SDA GPIO"
        depends on MOTION_OLED
        default 21
        help
            If nothing answers on this pin pair at boot, common pin pairs are scanned
            and the working one is logged ("OLED found at ... SDA=.. SCL=..").

    config MOTION_OLED_SCL
        int "OLED SCL GPIO"
        depends on MOTION_OLED
        default 22

    config MOTION_OLED_ADDR
        hex "OLED I2C address"
        depends on MOTION_OLED
        default 0x3C

    config MOTION_OLED_RST
        int "OLED reset GPIO (-1 = none; Heltec boards use 16)"
        depends on MOTION_OLED
        range -1 39
        default -1

endmenu
```
